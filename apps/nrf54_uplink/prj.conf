## CMakeLists.txt
```
cmake_minimum_required(VERSION 3.20.0)

# M3c.2: mic -> LC3 -> BLE uplink. Real audio_stream/lc3_codec/ble_audio/mic_vad;
# gesture_mode + audio_downlink stubbed (uplink-only, force dictation via `d`).

find_package(Zephyr REQUIRED HINTS $ENV{ZEPHYR_BASE})
project(nrf54_uplink)

set(SHARED ${CMAKE_CURRENT_SOURCE_DIR}/../../src)

target_sources(app PRIVATE
    src/main.cpp
    src/gesture_mode_stub.cpp
    src/audio_downlink_stub.cpp
    ${SHARED}/mic_vad.cpp
    ${SHARED}/mic_vad_rms.cpp
    ${SHARED}/audio_stream.cpp
    ${SHARED}/lc3_codec.c
    ${SHARED}/ble_audio.cpp
)
target_include_directories(app PRIVATE ${SHARED})
```

## prj.conf
```kconfig
# M3c.2: console + mic + LC3 encode + BLE LC3 uplink.
CONFIG_CPP=y
CONFIG_STD_CPP17=y
CONFIG_NEWLIB_LIBC=y
CONFIG_NEWLIB_LIBC_FLOAT_PRINTF=y

# FPU + CMSIS-DSP (mic_vad rFFT) + FPU sharing (LC3 encoder runs on the audio
# thread; multi-thread FPU use must be correct).
CONFIG_FPU=y
CONFIG_FPU_SHARING=y
CONFIG_CMSIS_DSP=y
CONFIG_CMSIS_DSP_TRANSFORM=y
CONFIG_CMSIS_DSP_FASTMATH=y
CONFIG_CMSIS_DSP_COMPLEXMATH=y
CONFIG_CMSIS_DSP_STATISTICS=y

CONFIG_LOG=y
CONFIG_LOG_MODE_IMMEDIATE=y

CONFIG_SERIAL=y
CONFIG_CONSOLE=y
CONFIG_UART_CONSOLE=y
CONFIG_UART_INTERRUPT_DRIVEN=y
CONFIG_REBOOT=y

CONFIG_MAIN_STACK_SIZE=4096
CONFIG_SYSTEM_WORKQUEUE_STACK_SIZE=4096
CONFIG_HEAP_MEM_POOL_SIZE=4096

CONFIG_GPIO=y
CONFIG_I2C=y

# nPM1300 LDO1 powers the mic rail
CONFIG_REGULATOR=y
CONFIG_REGULATOR_NPM13XX=y
CONFIG_MFD=y

# PDM mic
CONFIG_AUDIO=y
CONFIG_AUDIO_DMIC=y
CONFIG_AUDIO_DMIC_NRFX_PDM=y

# LC3 encoder (Google liblc3, shipped with NCS)
CONFIG_LIBLC3=y

# BLE peripheral + throughput for the 82 B audio notification
CONFIG_BT=y
CONFIG_BT_PERIPHERAL=y
CONFIG_BT_DEVICE_NAME="gband-uplink"
CONFIG_BT_L2CAP_TX_MTU=247
CONFIG_BT_BUF_ACL_TX_SIZE=251
CONFIG_BT_BUF_ACL_RX_SIZE=251
```

## src/main.cpp
```c
/*
 * nRF54LM20A OLED variant -- M3c.2: mic -> LC3 -> BLE uplink.
 *
 * The full uplink path: mic_vad captures 20 ms PCM blocks and feeds audio_stream;
 * when dictation is active AND a host has subscribed to the audio characteristic,
 * the audio thread LC3-encodes each block and notifies it over BLE
 * (ble_audio, wire format [seq16][ts32][LC3], see docs/device-ble-contract.md).
 *
 * gesture_mode is stubbed here -- press `d` to force MODE_DICTATION on/off so the
 * uplink can be exercised without the full gesture FSM. audio_downlink is stubbed
 * (the OLED variant has no speaker/downlink).
 *
 * Console: r reboot, b boot-info, d toggle dictation (streaming gate).
 */
#include <zephyr/kernel.h>
#include <zephyr/device.h>
#include <zephyr/drivers/uart.h>
#include <zephyr/sys/reboot.h>
#include <zephyr/sys/atomic.h>
#include <zephyr/logging/log.h>

#include <zephyr/bluetooth/bluetooth.h>
#include <zephyr/bluetooth/conn.h>

#include "mic_vad.h"
#include "audio_stream.h"
#include "ble_audio.h"
#include "gesture_mode.h"

LOG_MODULE_REGISTER(main, LOG_LEVEL_INF);

extern "C" void gesture_mode_stub_set(GestureMode m);

#define DEVICE_NAME     CONFIG_BT_DEVICE_NAME
#define DEVICE_NAME_LEN (sizeof(DEVICE_NAME) - 1)

static const struct device *const console_dev =
	DEVICE_DT_GET(DT_CHOSEN(zephyr_console));

static atomic_t dictation = ATOMIC_INIT(0);

static const struct bt_data ad[] = {
	BT_DATA_BYTES(BT_DATA_FLAGS, (BT_LE_AD_GENERAL | BT_LE_AD_NO_BREDR)),
	BT_DATA(BT_DATA_NAME_COMPLETE, DEVICE_NAME, DEVICE_NAME_LEN),
};

#define ADV_PARAM BT_LE_ADV_PARAM(BT_LE_ADV_OPT_CONN, \
	BT_GAP_ADV_FAST_INT_MIN_2, BT_GAP_ADV_FAST_INT_MAX_2, NULL)

static void start_adv(void)
{
	int err = bt_le_adv_start(ADV_PARAM, ad, ARRAY_SIZE(ad), NULL, 0);
	if (err) {
		LOG_ERR("advertising start failed: %d", err);
	} else {
		LOG_INF("advertising as \"%s\"", DEVICE_NAME);
	}
}

/* Advertising restart on disconnect (ble_audio has its own conn cb for the
 * audio_conn tracking; multiple conn callbacks coexist). */
static void on_disconnected(struct bt_conn *conn, uint8_t reason)
{
	ARG_UNUSED(conn);
	LOG_INF("disconnected (reason 0x%02x) -> re-advertising", reason);
	start_adv();
}
BT_CONN_CB_DEFINE(app_conn_cb) = {
	.disconnected = on_disconnected,
};

static void set_dictation(bool on)
{
	atomic_set(&dictation, on ? 1 : 0);
	gesture_mode_stub_set(on ? MODE_DICTATION : MODE_IDLE);
	LOG_INF("dictation %s (streams when host subscribed: %s)",
		on ? "ON" : "OFF",
		ble_audio_subscribed() ? "yes" : "not yet");
}

static void uart_rx_cb(const struct device *dev, void *user_data)
{
	ARG_UNUSED(user_data);
	uint8_t ch;

	if (!uart_irq_update(dev) || !uart_irq_rx_ready(dev)) {
		return;
	}
	while (uart_fifo_read(dev, &ch, 1) == 1) {
		switch (ch) {
		case 'r':
			LOG_INF("reboot (cold)");
			sys_reboot(SYS_REBOOT_COLD);
			break;
		case 'b':
			LOG_INF("no UF2 bootloader on nRF54L -- flash via "
				"./flash_nrf54.sh; rebooting cold");
			sys_reboot(SYS_REBOOT_COLD);
			break;
		case 'd':
			set_dictation(!atomic_get(&dictation));
			break;
		default:
			break;
		}
	}
}

int main(void)
{
	LOG_INF("=== gestureband nRF54LM20A OLED variant -- M3c.2 LC3 uplink ===");

	if (device_is_ready(console_dev)) {
		uart_irq_callback_user_data_set(console_dev, uart_rx_cb, NULL);
		uart_irq_rx_enable(console_dev);
		LOG_INF("console: r reboot, b boot-info, d toggle dictation");
	}

	mic_vad_init();
	mic_vad_start();          /* capture continuously; feeds audio_stream */
	audio_stream_init();      /* LC3 codec init (audio thread auto-starts) */

	int err = bt_enable(NULL);
	if (err) {
		LOG_ERR("bt_enable failed: %d", err);
		return 0;
	}
	LOG_INF("bluetooth enabled");
	start_adv();

	LOG_INF("ready: connect + subscribe to the audio char, press 'd', then speak");

	/* Periodic status so the streaming gate state is visible. */
	while (1) {
		if (atomic_get(&dictation)) {
			LOG_INF("[uplink] dictation=ON subscribed=%d drops=%u",
				ble_audio_subscribed(), ble_audio_drop_count());
		}
		k_sleep(K_SECONDS(2));
	}
	return 0;
}
```

## src/audio_downlink_stub.cpp
```c
/*
 * M3c.2 stub for audio_downlink: ble_audio's downlink characteristic forwards to
 * audio_downlink_feed()/flush(). The OLED variant has NO speaker/downlink (M4
 * removes it), so these are no-ops -- the uplink path is what M3c.2 exercises.
 */
#include "audio_downlink.h"

void audio_downlink_feed(const uint8_t *lc3, size_t len) { (void)lc3; (void)len; }
void audio_downlink_flush(void) {}
```

## src/gesture_mode_stub.cpp
```c
/*
 * M3c.2 stub for gesture_mode: audio_stream gates on gesture_mode_get() ==
 * MODE_DICTATION. Without the full gesture FSM here, this lets the test app
 * force the mode on/off (serial `d`) so the LC3 uplink can be exercised.
 */
#include "gesture_mode.h"

static volatile GestureMode forced_mode = MODE_IDLE;

extern "C" GestureMode gesture_mode_get(void)
{
	return forced_mode;
}

/* Test-only setter (not part of the real gesture_mode API). */
extern "C" void gesture_mode_stub_set(GestureMode m)
{
	forced_mode = m;
}
```
