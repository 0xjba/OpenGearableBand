## boards/seeed/xiao_nrf54lm20a/Kconfig.defconfig
```kconfig
# Copyright (c) 2026 gestureband
# SPDX-License-Identifier: Apache-2.0

if BOARD_XIAO_NRF54LM20A_NRF54LM20A_CPUAPP

config HW_STACK_PROTECTION
	default ARCH_HAS_STACK_PROTECTION

endif # BOARD_XIAO_NRF54LM20A_NRF54LM20A_CPUAPP
```

## boards/seeed/xiao_nrf54lm20a/board.yml
```yaml
board:
  name: xiao_nrf54lm20a
  full_name: XIAO nRF54LM20A Sense
  vendor: seeed
  socs:
  - name: nrf54lm20a
```
